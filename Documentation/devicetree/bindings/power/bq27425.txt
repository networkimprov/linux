## Documentation/devicetree/bindings/power/bq27425.txt
```
* TI BQ27425 Fuel Gauge

http://www.ti.com/lit/ds/symlink/bq27425-g2a.pdf

Please note that if any of the optional properties are defined
then all settings must be.

Required properties:
- compatible: Should be "ti,bq27425"
- reg: integer, I2C address of the device

Optional properties:
- monitored-battery: phandle of battery information devicetree node

bq27425 {
	compatible = "ti,bq27425";
	reg = <0x55>;

	monitored-battery = <&bat>;
};
```

## Documentation/devicetree/bindings/power/supply/battery.txt
```
Battery Characteristics

Required Properties:
 - compatible: Must be "fixed-battery"

Optional Properties:
 - terminal-microvolt: dead battery voltage
 - design-microwatt-hours: battery design energy
 - design-microamp-hours: battery design capacity

Batteries must be referenced by chargers and/or fuel-gauges
using a phandle. The phandle's property should be named
"monitored-battery".

Example:

	bat: battery {
		compatible = "fixed-battery";
		terminal-microvolt = <3700000>;
		design-microwatt-hours = <5290000>;
		design-microamp-hours = <1430000>;
	};

	charger: charger@0 {
		....
		monitored-battery = <&bat>;
		...
	};

	fuel_gauge: fuel_gauge@0 {
		....
		monitored-battery = <&bat>;
		...
	};
```

## Documentation/devicetree/bindings/power/supply/bq24190.txt
```
Binding for TI BQ24190 Li-Ion Battery Charger

Required properties:
- compatible: Should contain one of the following:
    * "ti,bq24190"
- reg: integer, I2C address of the device.

Optional properties:
- monitored-battery: phandle of battery information devicetree node
    These battery properties are relevant:
    + precharge-current-microamp: maximum charge current during precharge
      phase (typically 20% of battery capacity).
    + endcharge-current-microamp: a charge cycle terminates when the
      battery voltage is above recharge threshold, and the current is below
      this setting (typically 10% of battery capacity).
    See Documentation/devicetree/bindings/power/supply/battery.txt
- ti,system-minimum-microvolt: when power is connected and the battery
    is below minimum system voltage, the system will be regulated above this
    setting.

Other features:
- Use gpio-hog to set the OTG pin high to enable 500mA charge current on USB SDP port.

Example:

bat: battery {
	compatible = "simple-battery";
	precharge-current-microamp = <256000>;
	endcharge-current-microamp = <128000>;
};

bq24190 charger@6a {
	compatible = "ti,bq24190";
	reg = <0x6a>;
	// interrupt configuration here
	monitored-battery = <&bat>;
	ti,system-minimum-microvolt = <3200000>;
};

&twl_gpio {
	otg {
		gpio-hog;
		gpios = <6 0>;
		output-high;
		line-name = "otg-gpio";
	};
};
```
